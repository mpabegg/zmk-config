## boards/shields/forager/Kconfig.shield
```kconfig
# Copyright (c) 2020 The ZMK Contributors
# SPDX-License-Identifier: MIT

config SHIELD_FORAGER_CENTRAL_DONGLE
	def_bool $(shields_list_contains,forager_central_dongle)

config SHIELD_FORAGER_CENTRAL_LEFT
    def_bool $(shields_list_contains,forager_central_left)

config SHIELD_FORAGER_PERIPHERAL_LEFT
    def_bool $(shields_list_contains,forager_peripheral_left)

config SHIELD_FORAGER_PERIPHERAL_RIGHT
    def_bool $(shields_list_contains,forager_peripheral_right)
```
