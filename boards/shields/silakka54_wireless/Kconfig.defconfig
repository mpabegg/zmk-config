## boards/shields/silakka54_wireless/Kconfig.defconfig
```kconfig
# SPDX-License-Identifier: MIT

if SHIELD_SILAKKA54_WIRELESS_LEFT

config ZMK_KEYBOARD_NAME
    default "Silakka54"

config ZMK_SPLIT_ROLE_CENTRAL
    default y

endif

if SHIELD_SILAKKA54_WIRELESS_LEFT || SHIELD_SILAKKA54_WIRELESS_RIGHT

config ZMK_SPLIT
    default y

endif
```

## boards/shields/silakka54_wireless/Kconfig.shield
```kconfig
# SPDX-License-Identifier: MIT

config SHIELD_SILAKKA54_WIRELESS_LEFT
    def_bool $(shields_list_contains,silakka54_wireless_left)

config SHIELD_SILAKKA54_WIRELESS_RIGHT
    def_bool $(shields_list_contains,silakka54_wireless_right)
```

## config/west.yml
```yaml
manifest:
  defaults:
    revision: v0.3 # ZMK release; modules are pinned to their matching release
  remotes:
    - name: zmkfirmware
      url-base: https://github.com/zmkfirmware
    - name: urob
      url-base: https://github.com/urob
    - name: caksoylar
      url-base: https://github.com/caksoylar
  projects:
    - name: zmk
      remote: zmkfirmware
      import: app/west.yml
    - name: zmk-tri-state
      remote: urob
    - name: zmk-rgbled-widget
      remote: caksoylar
  self:
    path: config
```
